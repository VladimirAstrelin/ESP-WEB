#include <Arduino.h>
#include <Wire.h> // Библиотека для работы с протоколом I2C , SDA (данные) и SCL (тактовый сигнал)
#include <Adafruit_GFX.h>
#include <Adafruit_SSD1306.h>

// ============================================================
// НАСТРОЙКИ ДИСПЛЕЯ
// ============================================================

#define SCREEN_WIDTH 128 // Ширина дисплея — 128 пикселей (точек по горизонтали)
#define SCREEN_HEIGHT 64 // Высота дисплея — 64 пикселя (точек по вертикали)

#define OLED_RESET -1
// Пин сброса дисплея. Значение -1 означает "не используется"
// — наш дисплей сбрасывается автоматически.

#define SCREEN_ADDRESS 0x3C
// Адрес дисплея на шине I2C. 

// Создаём объект дисплея. Теперь мы будем управлять дисплеем через переменную "display"
Adafruit_SSD1306 display(SCREEN_WIDTH, SCREEN_HEIGHT, &Wire, OLED_RESET);

// ============================================================
// НАСТРОЙКИ ПИНОВ
// ============================================================

// ВАЖНО ДЛЯ ESP32 DEV MODULE: GPIO1 = TX, GPIO3 = RX — эти пины НЕЛЬЗЯ использовать!
// TX и RX — это пины для Serial (USB-соединения с компьютером).
// Если подключить к ним кнопку — данные из браузера не дойдут!

const uint8_t BTN1 = 15;
// Кнопка 1 подключена к пину номер 15.

const uint8_t BTN2 = 16;
// Кнопка 2 подключена к пину номер 16.

const uint8_t BTN3 = 4;
// Кнопка 3 подключена к пину номер 4. 

const uint8_t LED_PIN = 2;
// Встроенный светодиод (LED) на плате ESP32 подключён к пину 2.

// ============================================================
// НАСТРОЙКИ ШИМ (PWM) ДЛЯ УПРАВЛЕНИЯ ЯРКОСТЬЮ LED
// ШИМ (PWM) — это способ управлять яркостью светодиода.
// Вместо того чтобы просто включить/выключить, мы очень быстро
// мигаем светодиодом — и он кажется более тёмным или ярким.
// ESP32 не имеет обычного analogWrite(), поэтому используем
// специальные функции: ledcSetup, ledcAttachPin, ledcWrite.
// ============================================================

const int PWM_CHANNEL = 0;
// Номер ШИМ-канала. ESP32 имеет 16 каналов (0-15). Мы используем канал 0.

const int PWM_FREQ = 5000;
// Частота ШИМ — 5000 Гц (5000 раз в секунду светодиод
// включается и выключается). Человеческий глаз этого не видит,
// поэтому кажется что светодиод просто светит определённой яркостью.

const int PWM_RESOLUTION = 8;
// Разрешение ШИМ — 8 бит. Это значит яркость можно задать
// числом от 0 (выключен) до 255 (полная яркость).
// 2 в степени 8 = 256 градаций яркости.


// ============================================================
// ПЕРЕМЕННЫЕ ДЛЯ КНОПОК
// ============================================================

bool lastBtn1 = HIGH;
// Здесь храним ПРЕДЫДУЩЕЕ состояние кнопки 1.
// HIGH — кнопка отпущена (через резистор подтяжки на ней +3.3В).

bool lastBtn2 = HIGH;
// Предыдущее состояние кнопки 2. Тоже отпущена = HIGH.

bool lastBtn3 = HIGH;
// Предыдущее состояние кнопки 3. Тоже отпущена = HIGH.

unsigned long lastBtn1Time = 0;
// Здесь храним время последнего нажатия кнопки 1 в миллисекундах.
// Используется для защиты от "дребезга" контактов.

unsigned long lastBtn2Time = 0;
// Время последнего нажатия кнопки 2.

unsigned long lastBtn3Time = 0;
// Время последнего нажатия кнопки 3.

const unsigned long debounceDelay = 50;
// Защита от "Дребезга" контактов. Если с момента последнего нажатия прошло меньше
// 50 миллисекунд — игнорируем это нажатие.

// ============================================================
// ПЕРЕМЕННЫЕ ДЛЯ СВЕТОДИОДА
// ============================================================

String ledMode = "OFF";
// Здесь храним текущий режим работы светодиода.
// Возможные значения: "OFF", "ON", "BLINK", "FADE"

unsigned long lastBlinkTime = 0;
// Время последнего переключения светодиода в режиме мигания.
// Нужно чтобы знать — пора ли переключить LED или ещё рано.

unsigned long blinkInterval = 500;
// Интервал мигания в миллисекундах.
// 500 мс = 0.5 секунды. То есть LED будет переключаться
// каждые полсекунды (1 полный цикл вкл/выкл = 1 секунда).

unsigned long lastFadeTime = 0;
// Время последнего изменения яркости в режиме "дыхания".

const unsigned long fadeInterval = 30;
// Как часто менять яркость в режиме "дыхания" — каждые 30 мс.
// Чем меньше число — тем быстрее изменяется яркость.

int fadeValue = 0;
// Текущая яркость светодиода (0 = выключен, 255 = максимум).
// В режиме "дыхания" это значение плавно растёт и убывает.

int fadeDirection = 5;
// На сколько меняем яркость за один шаг.
// +5 = яркость растёт, -5 = яркость убывает.
// Когда достигаем 0 или 255 — меняем направление на обратное.

int blinkFrequency = 5;
// Частота мигания — число от 1 до 10.
// 1 = медленно, 10 = быстро. По умолчанию 5 (средняя скорость).

bool blinkState = false;
// Текущее состояние LED в режиме мигания:
// false = выключен, true = включён.

// ============================================================
// БУФЕР ДЛЯ ПРИЁМА ДАННЫХ
// ============================================================

String inputBuffer = "";
// Буфер — это временное хранилище. Данные из браузера
// приходят по одному символу за раз. Мы копим их здесь,
// пока не получим символ '\n' (конец строки).
// Например: 'L' → 'LE' → 'LED' → 'LED:' → 'LED:ON' → 'LED:ON\n'
// Когда получили '\n' — значит команда полная, обрабатываем!


// ============================================================
// ВЫВОД ТЕКСТА НА ДИСПЛЕЙ
// ============================================================

void displayText(String text) {
    display.clearDisplay();
    // Очищаем дисплей — стираем всё что было нарисовано раньше.
    // Если не очистить — новый текст напишется поверх старого.

    display.setTextSize(1);
    // Размер текста 1 = самый маленький (каждая буква 6x8 пикселей).
    // Размер 2 = буквы в 2 раза больше (12x16 пикселей), и т.д.

    display.setTextColor(SSD1306_WHITE);
    // Цвет текста — белый. На OLED дисплее пиксели либо светятся
    // (белый), либо нет (чёрный). Других цветов нет.

    display.setCursor(0, 0);
    // Устанавливаем курсор в позицию x=0, y=0 — это левый верхний угол.
    // Отсюда начнёт рисоваться текст.

    display.println(text);
    // Выводим текст. println = print + новая строка в конце.
    // Переменная text содержит то, что пришло из браузера.

    display.display();
    // ВАЖНО! Без этой команды ничего не появится на экране!
    // Все предыдущие команды рисовали в скрытой памяти (буфере).
    // display() — отправляет буфер на реальный экран.
}


// ============================================================
// ПЕРЕСЧЁТ ИНТЕРВАЛА МИГАНИЯ
// Переводит значение частоты (1-10) в реальный интервал (мс).
// ============================================================

void updateBlinkInterval() {
    blinkInterval = 2100 - (blinkFrequency * 200);
    // Формула: при частоте 1 → 2100 - 200 = 1900 мс (медленно)
    //          при частоте 5 → 2100 - 1000 = 1100 мс (средне)
    //          при частоте 10 → 2100 - 2000 = 100 мс (быстро)
    // Чем больше частота — тем меньше интервал — тем быстрее мигает.
}

// ============================================================
// УСТАНОВКА РЕЖИМА СВЕТОДИОДА
// Принимает строку с названием режима и настраивает LED.
// ============================================================

void setLedMode(String mode) {
    ledMode = mode;
    // Запоминаем новый режим в глобальной переменной.
    // Это нужно для функции updateLedEffects() в loop().

    if (mode == "OFF") {
        // Если команда "выключить":
        ledcWrite(PWM_CHANNEL, 0);
        // Устанавливаем яркость 0 = светодиод выключен.
        // ledcWrite(канал, яркость) — ESP32-шная замена analogWrite().

        Serial.println("LED_OFF_OK");
        // Отправляем подтверждение обратно в браузер.
        // Serial.println() отправляет текст + символ новой строки '\n'.
        // Браузер получит "LED_OFF_OK" и покажет в логе.
    }
    else if (mode == "ON") {
        // Если команда "включить":
        ledcWrite(PWM_CHANNEL, 255);
        // Яркость 255 = максимум = светодиод горит на полную.

        Serial.println("LED_ON_OK");
        // Подтверждение браузеру.
    }
    else if (mode == "BLINK") {
        // Если команда "мигать":
        blinkState = true;
        // Начинаем с включённого состояния.

        lastBlinkTime = millis();
        // millis() возвращает количество миллисекунд с момента
        // включения ESP32. Запоминаем это время как "старт мигания".

        ledcWrite(PWM_CHANNEL, 255);
        // Сразу включаем LED.

        updateBlinkInterval();
        // Пересчитываем интервал под текущую частоту.

        Serial.println("LED_BLINK_OK");
        // Подтверждение браузеру.
    }
    else if (mode == "FADE") {
        // Если команда "дыхание" (плавное изменение яркости):
        fadeValue = 0;
        // Начинаем с нуля — светодиод выключен.

        fadeDirection = 5;
        // Начинаем увеличивать яркость (+ 5 за каждый шаг).

        ledcWrite(PWM_CHANNEL, fadeValue);
        // Устанавливаем начальную яркость = 0.

        Serial.println("LED_FADE_OK");
        // Подтверждение браузеру.
    }
}


// ============================================================
// ОБНОВЛЕНИЕ ЭФФЕКТОВ СВЕТОДИОДА
// Эта функция вызывается в loop() — то есть очень часто.
// Она проверяет: пора ли переключить LED, и если да — делает это.
// ============================================================

void updateLedEffects() {
    unsigned long currentMillis = millis();
    // Узнаём текущее время (мс с момента включения ESP32).
    // Это как посмотреть на часы.

    if (ledMode == "BLINK") {
        // Если сейчас режим мигания:

        if (currentMillis - lastBlinkTime >= blinkInterval) {
            // Вычисляем сколько прошло времени с последнего переключения.
            // Если прошло БОЛЬШЕ чем blinkInterval — пора переключить!
            // Например: сейчас 1500 мс, последнее переключение в 1000 мс,
            // интервал 400 мс. 1500 - 1000 = 500 >= 400. Переключаем!

            blinkState = !blinkState;
            // ! — логическое "НЕ". Инвертируем состояние:
            // если было true → станет false, и наоборот.

            ledcWrite(PWM_CHANNEL, blinkState ? 255 : 0);
            // Тернарный оператор: условие ? значение_если_true : значение_если_false
            // Если blinkState = true → яркость 255 (включён)
            // Если blinkState = false → яркость 0 (выключен)

            lastBlinkTime = currentMillis;
            // Запоминаем время переключения. Отсчёт пойдёт заново.
        }
    }
    else if (ledMode == "FADE") {
        // Если сейчас режим "дыхания":

        if (currentMillis - lastFadeTime >= fadeInterval) {
            // Если прошло 30 мс с последнего изменения яркости:

            fadeValue += fadeDirection;
            // Меняем яркость на величину шага (+ или - 5).

            if (fadeValue <= 0) {
                // Если яркость стала 0 или меньше (достигли минимума):
                fadeValue = 0;
                // Фиксируем на 0 (не уходим в отрицательные числа).
                fadeDirection = 5;
                // Меняем направление: теперь будем увеличивать яркость.
            }
            if (fadeValue >= 255) {
                // Если яркость стала 255 или больше (достигли максимума):
                fadeValue = 255;
                // Фиксируем на 255 (не уходим за пределы).
                fadeDirection = -5;
                // Меняем направление: теперь будем уменьшать яркость.
            }

            ledcWrite(PWM_CHANNEL, fadeValue);
            // Устанавливаем новую яркость на светодиоде.

            lastFadeTime = currentMillis;
            // Запоминаем время изменения. Отсчёт пойдёт заново.
        }
    }
}


// ============================================================
// SETUP — выполняется ОДИН РАЗ при включении ESP32
// Здесь настраиваем всё необходимое перед началом работы.
// ============================================================

void setup() {

    // --- НАСТРОЙКА КНОПОК ---
    pinMode(BTN1, INPUT_PULLUP);
    // pinMode задаёт режим работы пина.
    // INPUT_PULLUP = вход с внутренней подтяжкой к питанию.
    // Это значит: когда кнопка НЕ нажата → на пине HIGH (3.3В).
    // Когда кнопка нажата (замыкает на GND) → на пине LOW (0В).
    // Подтяжка нужна чтобы пин не "висел в воздухе" — иначе
    // он ловил бы помехи и кнопки срабатывали бы сами собой.

    pinMode(BTN2, INPUT_PULLUP);
    // То же самое для кнопки 2.

    pinMode(BTN3, INPUT_PULLUP);
    // То же самое для кнопки 3.

    // --- НАСТРОЙКА ШИМ ДЛЯ СВЕТОДИОДА ---
    ledcSetup(PWM_CHANNEL, PWM_FREQ, PWM_RESOLUTION);
    // Настраиваем ШИМ-канал 0: частота 5000 Гц, разрешение 8 бит.
    // Это нужно сделать один раз перед использованием ledcWrite().

    ledcAttachPin(LED_PIN, PWM_CHANNEL);
    // "Привязываем" пин 2 (LED) к ШИМ-каналу 0.
    // Теперь ledcWrite(0, яркость) будет управлять именно этим пином.

    ledcWrite(PWM_CHANNEL, 0);
    // Сразу выключаем LED (яркость = 0).

    // --- НАСТРОЙКА SERIAL ---
    Serial.begin(115200);
    // Запускаем последовательный порт (USB-соединение с компьютером).
    // 115200 — это скорость передачи данных (бит в секунду = бод).
    // ВАЖНО: в браузере и здесь должна быть одинаковая скорость!

    delay(1000);
    // Ждём 1000 миллисекунд = 1 секунду.
    // Небольшая пауза для стабилизации питания и Serial-соединения.

    // --- ИНИЦИАЛИЗАЦИЯ ДИСПЛЕЯ ---
    Wire.begin();
    // Запускаем I2C шину на стандартных пинах ESP32:
    // SDA = GPIO21, SCL = GPIO22.

    if (display.begin(SSD1306_SWITCHCAPVCC, SCREEN_ADDRESS)) {
        // Пробуем инициализировать дисплей по адресу 0x3C.
        // SSD1306_SWITCHCAPVCC = использовать встроенный преобразователь
        // напряжения дисплея (для питания от 3.3В).
        // if(...) — выполняем блок только если инициализация успешна.

        display.clearDisplay();
        // Очищаем дисплей от мусора (при включении там может быть случайный шум в памяти).

        display.setTextSize(2);
        // Большой текст размером 2 — хорошо видно при старте.

        display.setTextColor(SSD1306_WHITE);
        // Белый цвет текста.

        display.setCursor(0, 0);
        // Курсор в левый верхний угол.

        display.println("ESP32");
        // Пишем слово "ESP32" и переходим на следующую строку.

        display.println("Ready!");
        // Пишем "Ready!" — дисплей сигнализирует что готов к работе.

        display.display();
        // Отправляем всё на экран.

        delay(2000);
        // Ждём 2 секунды чтобы успеть прочитать надпись.

        display.clearDisplay();
        // Очищаем дисплей.

        display.display();
        // Показываем пустой экран (стираем надпись "ESP32 Ready!").
    }

    Serial.println("ARDUINO_READY");
    // Отправляем в браузер сигнал что ESP32 запустился и готов.
    // Браузер увидит эту строку и покажет "🚀 ESP32 готов к работе!".

    inputBuffer.reserve(500);
    // Заранее выделяем 500 байт памяти для строки inputBuffer.
    // Это оптимизация: без reserve() память выделялась бы маленькими
    // кусочками по мере роста строки — это медленно и неэффективно.
}


// ============================================================
// ФУНКЦИЯ LOOP — выполняется БЕСКОНЕЧНО после setup()
// Это главный цикл программы. ESP32 крутит его тысячи раз
// в секунду. Здесь мы обрабатываем все события.
// ============================================================

void loop() {

    // =========================================================
    // БЛОК 1: ЧТЕНИЕ ДАННЫХ ИЗ БРАУЗЕРА (через USB/Serial)
    // =========================================================

    while (Serial.available() > 0) {
        // Serial.available() возвращает количество байт, ожидающих
        // в буфере приёма. Если > 0 — есть непрочитанные данные.
        // while — повторяем пока есть данные (читаем все сразу).

        char c = Serial.read();
        // Читаем ОДИН символ из буфера приёма.
        // char — тип данных для одного символа (буква, цифра, знак).

        if (c == '\n') {
            // '\n' — символ новой строки (Enter, конец команды).
            // Браузер отправляет команды вида "LED:ON\n".
            // Когда получаем '\n' — команда полностью получена!

            if (inputBuffer.length() > 0) {
                // Проверяем что буфер не пустой (не пришёл пустой Enter).

                String cmd = inputBuffer;
                // Копируем содержимое буфера в переменную cmd.
                // Работаем с копией, чтобы сразу очистить буфер.

                cmd.trim();
                // trim() убирает пробелы и невидимые символы
                // в начале и конце строки (' ', '\r', '\t').
                // Например: "  LED:ON  " → "LED:ON"

                // --- Обрабатываем команду DISPLAY ---
                if (cmd.startsWith("DISPLAY:")) {
                    // startsWith() проверяет с чего начинается строка.
                    // Если команда начинается с "DISPLAY:" — это текст для дисплея.

                    String text = cmd.substring(8);
                    // substring(8) — берём строку начиная с позиции 8.
                    // "DISPLAY:Привет" → позиции: D=0,I=1,S=2,P=3,L=4,A=5,Y=6,:=7
                    // Значит с позиции 8 начинается "Привет".

                    text.trim();
                    // Убираем лишние пробелы из текста.

                    displayText(text);
                    // Вызываем нашу функцию — показываем текст на дисплее.

                    Serial.println("DISPLAY_OK");
                    // Отправляем подтверждение в браузер.
                }

                // --- Обрабатываем команды LED ---
                else if (cmd.startsWith("LED:")) {
                    // Если команда начинается с "LED:" — управление светодиодом.

                    String ledCmd = cmd.substring(4);
                    // Берём часть после "LED:".
                    // "LED:ON" → "ON"
                    // "LED:BLINK" → "BLINK"
                    // "LED:FREQ:7" → "FREQ:7"

                    ledCmd.trim();
                    // Убираем пробелы.

                    if (ledCmd == "ON") {
                        setLedMode("ON");
                        // Если пришло "ON" — включаем LED.
                    }
                    else if (ledCmd == "OFF") {
                        setLedMode("OFF");
                        // Если пришло "OFF" — выключаем LED.
                    }
                    else if (ledCmd == "BLINK") {
                        setLedMode("BLINK");
                        // Если пришло "BLINK" — режим мигания.
                    }
                    else if (ledCmd == "FADE") {
                        setLedMode("FADE");
                        // Если пришло "FADE" — режим "дыхания".
                    }
                    else if (ledCmd.startsWith("FREQ:")) {
                        // Если пришло "FREQ:5" (или другое число) — меняем частоту.

                        int freq = ledCmd.substring(5).toInt();
                        // substring(5) берёт часть после "FREQ:".
                        // "FREQ:7" → "7"
                        // toInt() преобразует строку "7" в число 7.

                        if (freq >= 1 && freq <= 10) {
                            // Проверяем что значение в допустимом диапазоне 1-10.
                            // && — логическое "И": оба условия должны быть верны.

                            blinkFrequency = freq;
                            // Сохраняем новую частоту.

                            updateBlinkInterval();
                            // Пересчитываем интервал мигания.

                            Serial.println("LED_FREQ_OK");
                            // Подтверждение браузеру.
                        }
                    }
                }

                inputBuffer = "";
                // Очищаем буфер — готовимся к следующей команде.
            }
        }
        else if (c != '\r') {
            // '\r' — символ возврата каретки (часть Windows-переноса строки \r\n).
            // Его мы игнорируем. Все остальные символы добавляем в буфер.

            inputBuffer += c;
            // += добавляет символ в конец строки.
            // 'L' → "L" → "LE" → "LED" → "LED:" → "LED:ON"

            if (inputBuffer.length() > 500) {
                // Защита от переполнения памяти.
                // Если в буфере накопилось больше 500 символов
                // без символа '\n' — что-то пошло не так.
                inputBuffer = "";
                // Очищаем буфер и начинаем заново.
            }
        }
    }


    // =========================================================
    // БЛОК 2: ОБНОВЛЕНИЕ ЭФФЕКТОВ СВЕТОДИОДА
    // =========================================================

    updateLedEffects();
    // Вызываем функцию управления LED. Она сама разберётся
    // что делать в зависимости от текущего режима (ledMode).
    // Вызывается каждый проход loop() — т.е. тысячи раз в секунду.
    // Но реальные действия происходят только по таймеру внутри.


    // =========================================================
    // БЛОК 3: ОБРАБОТКА НАЖАТИЙ КНОПОК
    // =========================================================

    unsigned long currentMillis = millis();
    // Получаем текущее время один раз для всех трёх кнопок.
    // Лучше так, чем вызывать millis() три раза отдельно.

    // --- КНОПКА 1 ---
    bool btn1 = digitalRead(BTN1);
    // digitalRead() читает состояние пина: HIGH (3.3В) или LOW (0В).
    // Кнопка отпущена = HIGH (подтяжка держит пин на 3.3В).
    // Кнопка нажата = LOW (кнопка замыкает пин на GND = 0В).

    if (btn1 == LOW && lastBtn1 == HIGH && (currentMillis - lastBtn1Time > debounceDelay)) {
        // Три условия ОДНОВРЕМЕННО (&&):
        // 1. btn1 == LOW   → кнопка СЕЙЧАС нажата
        // 2. lastBtn1 == HIGH → в ПРОШЛЫЙ раз была отпущена
        //    (значит это новое нажатие, а не удержание)
        // 3. прошло больше 50 мс с предыдущего нажатия
        //    (защита от дребезга контактов)

        Serial.println("BTN1_PRESSED");
        // Сообщаем браузеру что кнопка 1 нажата.

        displayText("BTN 1");
        // Показываем на дисплее какая кнопка нажата.

        lastBtn1Time = currentMillis;
        // Запоминаем время нажатия. Отсчёт debounce начнётся заново.
    }
    lastBtn1 = btn1;
    // ВАЖНО: запоминаем ТЕКУЩЕЕ состояние как "прошлое"
    // для следующего прохода loop().

    // --- КНОПКА 2 --- (аналогично кнопке 1)
    bool btn2 = digitalRead(BTN2);
    if (btn2 == LOW && lastBtn2 == HIGH && (currentMillis - lastBtn2Time > debounceDelay)) {
        Serial.println("BTN2_PRESSED");
        displayText("BTN 2");
        lastBtn2Time = currentMillis;
    }
    lastBtn2 = btn2;

    // --- КНОПКА 3 --- (аналогично кнопке 1)
    bool btn3 = digitalRead(BTN3);
    if (btn3 == LOW && lastBtn3 == HIGH && (currentMillis - lastBtn3Time > debounceDelay)) {
        Serial.println("BTN3_PRESSED");
        displayText("BTN 3");
        lastBtn3Time = currentMillis;
    }
    lastBtn3 = btn3;

    delay(10);
    // Небольшая пауза 10 миллисекунд в конце каждого прохода loop().
    // Зачем: даём ESP32 чуть "передохнуть", обработать системные задачи.
    // Без этой паузы loop() крутится так быстро, что иногда
    // могут возникать проблемы со стабильностью WiFi/Serial.
    // 10 мс — достаточно мало чтобы не пропустить нажатие кнопки,
    // и достаточно велико для стабильной работы системы.
}
