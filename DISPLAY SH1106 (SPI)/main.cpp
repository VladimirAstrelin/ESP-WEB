// main.cpp
// ============================================================
// Подключение необходимых библиотек
// ============================================================

// Стандартная библиотека Arduino для работы с пинами, Serial и т.д.
#include <Arduino.h>
// Библиотека U8g2 для управления дисплеями OLED (в том числе SH1106)
#include <U8g2lib.h>

// ============================================================
// НАСТРОЙКИ ДИСПЛЕЯ SH1106 128x64 (SPI)
// ============================================================

// Создаём объект для работы с дисплеем.
// U8G2_SH1106_128X64_NONAME_F_4W_HW_SPI - тип дисплея и способ подключения:
//   SH1106_128X64      - модель дисплея 128 на 64 точки
//   NONAME             - общая конфигурация без специфичных фикс
//   F                  - используем полный буфер (fast, занимает больше памяти)
//   4W_HW_SPI          - 4-проводной интерфейс SPI через АППАРАТНЫЙ SPI
// U8G2_R0              - без поворота (Rotation 0)
U8G2_SH1106_128X64_NONAME_F_4W_HW_SPI u8g2(
  U8G2_R0,   // Поворот экрана: R0 = 0°, R1=90°, R2=180°, R3=270°
  /* cs=*/ 5,      // CS (Chip Select) - выбор кристалла, подключён к GPIO5
  /* dc=*/ 2,      // DC (Data/Command) - команда или данные, подключён к GPIO2
  /* reset=*/ 4    // RES или RST - сброс дисплея, подключён к GPIO4
);

// По умолчанию для апаратного SPI используются пины:
//   SCK  -> GPIO18
//   MOSI -> GPIO23
// Их не нужно указывать отдельно.

// ============================================================
// НАСТРОЙКИ ПИНОВ (GPIO)
// ============================================================

// Константа: номер пина для тестовой кнопки (GPIO15).
// Подключение кнопки: один вывод к GND, другой к GPIO15.
// Используем внутренний PULLUP, поэтому резистор не нужен.
const uint8_t BTN_TEST = 15;

// Константа: номер пина для светодиода (GPIO13).
// GPIO2 занят дисплеем, так что используем свободный 13.
const uint8_t LED_PIN = 13;

// ============================================================
// ПЕРЕМЕННЫЕ ДЛЯ ОБРАБОТКИ КНОПКИ (АНТИДРЕБЕЗГ)
// ============================================================

// Переменная для хранения прошлого состояния кнопки (HIGH = не нажата)
bool lastBtnState = HIGH;
// Время последнего переключения кнопки (в миллисекундах)
unsigned long lastBtnTime = 0;
// Задержка для подавления "дребезга" контактов (50 мс)
const unsigned long debounceDelay = 50;

// ============================================================
// ПЕРЕМЕННЫЕ ДЛЯ УПРАВЛЕНИЯ СВЕТОДИОДОМ
// ============================================================

// Строка, хранящая текущий режим светодиода: "OFF", "ON", "BLINK"
String ledMode = "OFF";
// Время последнего переключения мигания (для режима BLINK)
unsigned long lastBlinkTime = 0;
// Интервал мигания: 500 мс (0.5 секунды)
unsigned long blinkInterval = 500;
// Текущее состояние мигания (вкл/выкл)
bool blinkState = false;

// ============================================================
// ПЕРЕМЕННЫЕ ДЛЯ ПРИЁМА КОМАНД ИЗ СЕРИЙНОГО ПОРТА
// ============================================================

// Буфер для накопления входящих символов (формируем строку до символа \n)
String inputBuffer = "";

// ============================================================
// ФУНКЦИЯ: ВЫВОД ОДНОЙ СТРОКИ ПО ЦЕНТРУ ЭКРАНА
// ============================================================

void displayText(String text) {
    // Очищаем внутренний буфер дисплея (подготовка к новой картинке)
    u8g2.clearBuffer();
    // Устанавливаем шрифт: жирный, размер 10 (хорошо читаемый)
    u8g2.setFont(u8g2_font_ncenB10_tr);
    
    // Вычисляем ширину текста в пикселях (чтобы потом центрировать)
    int textWidth = u8g2.getStrWidth(text.c_str());
    // Координата X для центрирования: (ширина экрана - ширина текста) / 2
    int x = (128 - textWidth) / 2;
    
    // Рисуем текст на буфере с координатами (x, 32). Y=32 - примерно центр по вертикали.
    u8g2.drawStr(x, 32, text.c_str());
    // Отправляем буфер на реальный экран (только после этого видим изменения)
    u8g2.sendBuffer();
}

// ============================================================
// ФУНКЦИЯ: ВЫВОД ТРЁХ СТРОК ПО ЦЕНТРУ (ДЛЯ ПРИВЕТСТВИЯ)
// ============================================================

void displayMultiLine(String line1, String line2, String line3) {
    u8g2.clearBuffer();                     // Очищаем буфер
    u8g2.setFont(u8g2_font_ncenB08_tr);    // Шрифт поменьше, чтобы влезло 3 строки
    
    // Вычисляем ширину каждой строки
    int w1 = u8g2.getStrWidth(line1.c_str());
    int w2 = u8g2.getStrWidth(line2.c_str());
    int w3 = u8g2.getStrWidth(line3.c_str());
    
    // Рисуем строки на разной высоте:
    // Y=15 (верх), Y=35 (середина), Y=55 (низ)
    u8g2.drawStr((128 - w1) / 2, 15, line1.c_str());
    u8g2.drawStr((128 - w2) / 2, 35, line2.c_str());
    u8g2.drawStr((128 - w3) / 2, 55, line3.c_str());
    
    u8g2.sendBuffer();  // Отображаем на экране
}

// ============================================================
// ФУНКЦИЯ: УПРАВЛЕНИЕ СВЕТОДИОДОМ В ЗАВИСИМОСТИ ОТ РЕЖИМА
// ============================================================

void setLedMode(String mode) {
    ledMode = mode;  // Запоминаем новый режим
    
    if (mode == "OFF") {
        digitalWrite(LED_PIN, LOW);   // Гасим светодиод (LOW = 0 вольт)
        Serial.println("LED_OFF_OK"); // Сообщаем компьютеру: "Выключил"
    }
    else if (mode == "ON") {
        digitalWrite(LED_PIN, HIGH);  // Зажигаем светодиод (HIGH = 3.3В)
        Serial.println("LED_ON_OK");
    }
    else if (mode == "BLINK") {
        // Сбрасываем состояние мигания, чтобы начать с выключенного
        blinkState = false;
        // Запоминаем текущее время для отсчёта интервалов
        lastBlinkTime = millis();
        Serial.println("LED_BLINK_OK");
    }
}

// ============================================================
// ФУНКЦИЯ: ОБНОВЛЕНИЕ ЭФФЕКТОВ СВЕТОДИОДА (МИГАНИЕ)
// Вызывается в каждом цикле loop()
// ============================================================

void updateLedEffects() {
    // Если режим "BLINK" (мигание)
    if (ledMode == "BLINK") {
        unsigned long currentMillis = millis();  // Текущее время в мс
        // Проверяем, прошёл ли интервал (500 мс)
        if (currentMillis - lastBlinkTime >= blinkInterval) {
            blinkState = !blinkState;            // Переключаем: true<->false
            // Если blinkState = true, подаём HIGH (вкл), иначе LOW (выкл)
            digitalWrite(LED_PIN, blinkState ? HIGH : LOW);
            lastBlinkTime = currentMillis;       // Сбрасываем таймер
        }
    }
}

// ============================================================
// ФУНКЦИЯ setup() — ВЫЗЫВАЕТСЯ ОДИН РАЗ ПРИ ВКЛЮЧЕНИИ ИЛИ СБРОСЕ
// ============================================================

void setup() {
    // Открываем последовательный порт (USB) со скоростью 115200 бод.
    // Эта скорость нужна для Web Serial API (браузеру так проще).
    Serial.begin(115200);
    delay(1000);  // Ждём секунду, чтобы стабилизировалось соединение
    
    // ------------------- НАСТРОЙКА ПИНОВ -------------------
    // Кнопка: вход с подтяжкой к питанию (INPUT_PULLUP).
    // В покое читаем HIGH (1), при нажатии кнопка тянет на GND -> LOW (0).
    pinMode(BTN_TEST, INPUT_PULLUP);
    // Светодиод: выход (можем подавать HIGH или LOW)
    pinMode(LED_PIN, OUTPUT);
    // На всякий случай сразу гасим светодиод
    digitalWrite(LED_PIN, LOW);
    
    // ------------------- ЗАПУСК ДИСПЛЕЯ -------------------
    u8g2.begin();            // Инициализируем дисплей
    u8g2.enableUTF8Print();  // Разрешаем поддержку UTF-8 (кириллица) - опционально
    
    // Показываем приветствие на экране
    displayMultiLine(
        "ESP32 Ready!",    // 1 строка: плата готова
        "SH1106 OK",       // 2 строка: дисплей работает
        "Web Serial OK"    // 3 строка: ждём команды через браузер
    );
    
    // ------------------- СООБЩЕНИЯ В СЕРИЙНЫЙ ПОРТ -------------------
    Serial.println("ARDUINO_READY");                     // Сигнал: плата включена
    Serial.println("ESP32 + SH1106 Initialized");        // Сообщаем, что всё инициализировано
    Serial.println("Button: GPIO 15");                   // Подсказка: куда подключена кнопка
    Serial.println("LED: GPIO 13");                      // Подсказка: где светодиод
    // Список команд, которые понимает прошивка:
    Serial.println("Commands: DISPLAY:text, LED:ON, LED:OFF, LED:BLINK");
}

// ============================================================
// ФУНКЦИЯ loop() — БЕСКОНЕЧНЫЙ ЦИКЛ, ВЫПОЛНЯЕТСЯ СНОВА И СНОВА
// ============================================================

void loop() {
    
    // =================================================================
    // БЛОК 1: ЧТЕНИЕ КОМАНД ИЗ WEB (ИЛИ МОНИТОРА ПОРТА)
    // Пока в порту есть данные, читаем посимвольно и собираем строку до \n
    // =================================================================
    
    // Serial.available() возвращает количество байт в буфере приёма.
    // Пока есть данные ( >0 ), читаем.
    while (Serial.available() > 0) {
        char c = Serial.read();    // Читаем один символ (байт)
        
        // Если символ - это перевод строки '\n' (Enter)
        if (c == '\n') {
            // Если буфер не пустой (что-то накопили)
            if (inputBuffer.length() > 0) {
                String cmd = inputBuffer;   // Копируем команду
                cmd.trim();                 // Удаляем лишние пробелы в начале и конце
                
                // ---------- КОМАНДА DISPLAY ----------
                // Проверяем, начинается ли строка с "DISPLAY:"
                if (cmd.startsWith("DISPLAY:")) {
                    // Берём подстроку после "DISPLAY:", т.е. сам текст для отображения
                    String text = cmd.substring(8);
                    text.trim();            // Убираем пробелы
                    displayText(text);      // Показываем на дисплее
                    Serial.println("DISPLAY_OK");  // Отвечаем браузеру: "Ок, показал"
                }
                
                // ---------- КОМАНДЫ LED ----------
                // Проверяем, начинается ли строка с "LED:"
                else if (cmd.startsWith("LED:")) {
                    // Берём подстроку после "LED:", получаем "ON", "OFF" или "BLINK"
                    String ledCmd = cmd.substring(4);
                    ledCmd.trim();           // Убираем пробелы
                    
                    if (ledCmd == "ON") {
                        setLedMode("ON");
                    }
                    else if (ledCmd == "OFF") {
                        setLedMode("OFF");
                    }
                    else if (ledCmd == "BLINK") {
                        setLedMode("BLINK");
                    }
                }
                
                // Очищаем буфер для следующей команды
                inputBuffer = "";
            }
        }
        // Если символ НЕ '\r' (возврат каретки, его игнорируем),
        // то добавляем его в конец буфера inputBuffer.
        else if (c != '\r') {
            inputBuffer += c;
            // Защита от переполнения: если буфер вырос больше 500 символов, чистим
            if (inputBuffer.length() > 500) {
                inputBuffer = "";
            }
        }
    }
    
    // =================================================================
    // БЛОК 2: ОБНОВЛЕНИЕ СОСТОЯНИЯ СВЕТОДИОДА (МИГАНИЕ)
    // =================================================================
    
    updateLedEffects();   // Если включён режим BLINK, переключаем каждые 500 мс
    
    // =================================================================
    // БЛОК 3: ОБРАБОТКА ТЕСТОВОЙ КНОПКИ (GPIO 15)
    // =================================================================
    
    unsigned long currentMillis = millis();        // Получаем текущее время в мс
    bool btnState = digitalRead(BTN_TEST);         // Читаем состояние кнопки (HIGH если не нажата)
    
    // Условие нажатия:
    // btnState == LOW     -> кнопка нажата (тянет на GND)
    // lastBtnState == HIGH-> раньше не была нажата
    // (currentMillis - lastBtnTime > debounceDelay) -> прошло >50 мс после предыдущего срабатывания
    if (btnState == LOW && lastBtnState == HIGH && 
        (currentMillis - lastBtnTime > debounceDelay)) {
        
        // Отправляем в серийный порт сообщение о нажатии (браузер покажет уведомление)
        Serial.println("BTN_TEST_PRESSED");
        // Показываем на дисплее сообщение "Button OK!"
        displayText("Button OK!");
        
        // Кратко включаем светодиод на 100 мс (приятная индикация)
        digitalWrite(LED_PIN, HIGH);
        delay(100);               // Ждём 100 миллисекунд
        digitalWrite(LED_PIN, LOW);
        
        // Обновляем время последнего нажатия (для защиты от дребезга)
        lastBtnTime = currentMillis;
    }
    
    // Запоминаем текущее состояние кнопки для следующего прохода цикла
    lastBtnState = btnState;
    
    // Небольшая задержка в 10 мс, чтобы не нагружать процессор
    // и чтобы кнопка и Serial успевали стабильно обрабатываться
    delay(10);
}